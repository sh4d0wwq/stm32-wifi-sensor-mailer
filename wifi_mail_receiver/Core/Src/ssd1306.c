#include "ssd1306.h"
#include "main.h"
#include <string.h>

#define OLED_W 128
#define OLED_PAGES 4

static const uint8_t font5x7[][5] = {
  {0x00,0x00,0x00,0x00,0x00}, {0x00,0x00,0x5F,0x00,0x00}, {0x00,0x07,0x00,0x07,0x00},
  {0x14,0x7F,0x14,0x7F,0x14}, {0x24,0x2A,0x7F,0x2A,0x12}, {0x23,0x13,0x08,0x64,0x62},
  {0x36,0x49,0x55,0x22,0x50}, {0x00,0x05,0x03,0x00,0x00}, {0x00,0x1C,0x22,0x41,0x00},
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  {0x07,0x08,0x70,0x08,0x07}, {0x61,0x51,0x49,0x45,0x43},
};

typedef struct
{
  GPIO_TypeDef *port;
  uint16_t scl;
  uint16_t sda;
} i2c_bus_t;

static const i2c_bus_t buses[] = {
  { GPIOB, GPIO_PIN_8, GPIO_PIN_9 },
  { GPIOC, GPIO_PIN_0, GPIO_PIN_1 },
};
static const i2c_bus_t *bus;
static uint8_t fb[OLED_W * OLED_PAGES];
static uint8_t addr7 = 0x3C;

static void dly(void)
{
  for (volatile uint32_t i = 0; i < 8; i++)
  {
    __NOP();
  }
}

static void sda_h(void) { HAL_GPIO_WritePin(bus->port, bus->sda, GPIO_PIN_SET); }
static void sda_l(void) { HAL_GPIO_WritePin(bus->port, bus->sda, GPIO_PIN_RESET); }
static void scl_h(void) { HAL_GPIO_WritePin(bus->port, bus->scl, GPIO_PIN_SET); }
static void scl_l(void) { HAL_GPIO_WritePin(bus->port, bus->scl, GPIO_PIN_RESET); }
static int sda_read(void) { return HAL_GPIO_ReadPin(bus->port, bus->sda) == GPIO_PIN_SET; }

static void i2c_start(void)
{
  sda_h();
  scl_h();
  dly();
  sda_l();
  dly();
  scl_l();
}

static void i2c_stop(void)
{
  sda_l();
  dly();
  scl_h();
  dly();
  sda_h();
  dly();
}

static int i2c_write_byte(uint8_t b)
{
  for (int i = 0; i < 8; i++)
  {
    if (b & 0x80)
    {
      sda_h();
    }
    else
    {
      sda_l();
    }
    b <<= 1;
    dly();
    scl_h();
    dly();
    scl_l();
  }
  sda_h();
  dly();
  scl_h();
  dly();
  int nack = sda_read();
  scl_l();
  return nack;
}

static int i2c_write(uint8_t ctrl, const uint8_t *data, uint16_t len)
{
  i2c_start();
  if (i2c_write_byte((uint8_t)(addr7 << 1)))
  {
    i2c_stop();
    return -1;
  }
  if (i2c_write_byte(ctrl))
  {
    i2c_stop();
    return -1;
  }
  for (uint16_t i = 0; i < len; i++)
  {
    if (i2c_write_byte(data[i]))
    {
      i2c_stop();
      return -1;
    }
  }
  i2c_stop();
  return 0;
}

static int cmd(uint8_t c)
{
  return i2c_write(0x00, &c, 1);
}

static int probe(uint8_t addr)
{
  addr7 = addr;
  i2c_start();
  int nack = i2c_write_byte((uint8_t)(addr7 << 1));
  i2c_stop();
  return nack == 0;
}

static void gpio_init(void)
{
  GPIO_InitTypeDef gpio = {0};
  uint32_t i;

  __HAL_RCC_GPIOB_CLK_ENABLE();
  __HAL_RCC_GPIOC_CLK_ENABLE();
  gpio.Mode = GPIO_MODE_OUTPUT_OD;
  gpio.Pull = GPIO_PULLUP;
  gpio.Speed = GPIO_SPEED_FREQ_HIGH;
  for (i = 0; i < sizeof(buses) / sizeof(buses[0]); i++)
  {
    gpio.Pin = buses[i].scl | buses[i].sda;
    HAL_GPIO_Init(buses[i].port, &gpio);
    HAL_GPIO_WritePin(buses[i].port, gpio.Pin, GPIO_PIN_SET);
  }
}

int SSD1306_Init(void)
{
  static const uint8_t seq[] = {
    0xAE,
    0xD5, 0x80,
    0xA8, 0x1F,
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    0x2E,
    0xAF
  };

  uint32_t n;
  int found = 0;

  gpio_init();
  HAL_Delay(100);
  for (n = 0; n < sizeof(buses) / sizeof(buses[0]); n++)
  {
    bus = &buses[n];
    if (probe(0x3C) || probe(0x3D))
    {
      found = 1;
      break;
    }
  }
  if (!found)
  {
    bus = 0;
    return -1;
  }
  for (uint32_t i = 0; i < sizeof(seq); i++)
  {
    if (cmd(seq[i]) != 0)
    {
      return -1;
    }
  }
  SSD1306_Clear();
  SSD1306_Update();
  return 0;
}

void SSD1306_Clear(void)
{
  memset(fb, 0, sizeof(fb));
}

void SSD1306_DrawString(int x, int page, const char *s)
{
  if (page < 0 || page >= OLED_PAGES)
  {
    return;
  }
  while (*s && x <= OLED_W - 6)
  {
    char c = *s++;
    if (c >= 'a' && c <= 'z')
    {
      c = (char)(c - 'a' + 'A');
    }
    if (c < 32 || c > 'Z')
    {
      c = ' ';
    }
    const uint8_t *g = font5x7[c - 32];
    for (int col = 0; col < 5; col++)
    {
      fb[page * OLED_W + x + col] = g[col];
    }
    x += 6;
  }
}

void SSD1306_Update(void)
{
  if (cmd(0x21) || cmd(0x00) || cmd(0x7F) || cmd(0x22) || cmd(0x00) || cmd(0x03))
  {
    return;
  }
  for (int i = 0; i < (int)sizeof(fb); i += 16)
  {
    if (i2c_write(0x40, &fb[i], 16) != 0)
    {
      return;
    }
  }
}
